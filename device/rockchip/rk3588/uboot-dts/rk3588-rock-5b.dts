// SPDX-License-Identifier: (GPL-2.0+ OR MIT)
/*
 * Copyright (c) 2024 Rockchip Electronics Co., Ltd.
 * Copyright (c) 2024 Radxa Computer (Shenzhen) Co., Ltd.
 *
 * U-Boot DTS for Radxa ROCK 5B.
 * Only includes peripherals needed during boot (UART, eMMC, SD, USB).
 * The full Linux DTS is in device/rockchip/rk3588/dts/ and is injected
 * into the kernel tree at build time by mk-kernel.sh.
 */

/dts-v1/;
#include "rk3588.dtsi"
#include "rk3588-u-boot.dtsi"
#include <dt-bindings/input/input.h>

/ {
	model = "Radxa ROCK 5B";
	compatible = "radxa,rock-5b", "rockchip,rk3588";
};
