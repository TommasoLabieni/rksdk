## yocto/meta-machines/conf/layer.conf
```bitbake
BBPATH .= ":${LAYERDIR}"
BBFILES += "${LAYERDIR}/recipes-*/*/*.bb ${LAYERDIR}/recipes-*/*/*.bbappend"
BBFILE_COLLECTIONS += "meta-machines"
BBFILE_PATTERN_meta-machines = "^${LAYERDIR}/"
BBFILE_PRIORITY_meta-machines = "10"
LAYERSERIES_COMPAT_meta-machines = "scarthgap"
```
