## device/rockchip/common/configs/Config.in
```kconfig
#

mainmenu "Rockchip Linux SDK Configuration"

config RK_DEFCONFIG_FROM_ENV
	string
	option env="RK_DEFCONFIG"

config RK_DEFCONFIG
	string "Name of defconfig to save"
	default RK_DEFCONFIG_FROM_ENV if RK_DEFCONFIG_FROM_ENV != ""
	default "rockchip_defconfig"

config RK_CHIP_FAMILY_FROM_ENV
	string
	option env="RK_CHIP_FAMILY"

config RK_CHIP_FAMILY
	string
	default RK_CHIP_FAMILY_FROM_ENV if RK_CHIP_FAMILY_FROM_ENV != ""

config RK_CHIP_FROM_ENV
	string
	option env="RK_CHIP"

config RK_CHIP
	string
	default RK_CHIP_FROM_ENV if RK_CHIP_FROM_ENV != ""
	default RK_CHIP_FAMILY

config RK_CHIP_ARM64
	bool
	default y

config RK_CHIP_HAS_GPU
	bool
	default y

source "Config.in.loader"
source "Config.in.amp"
source "Config.in.kernel"
source "Config.in.boot"
source "Config.in.rootfs"
source "Config.in.firmware"
source "Config.in.others"
```

## device/rockchip/rk3566_rk3568/amp_linux.its
```
/* SPDX-License-Identifier: BSD-3-Clause */
/*
 * Copyright (c) 2021 Rockchip Electronics Co., Ltd.
 */

/dts-v1/;
/ {
	description = "FIT source file for RK3568 AMP";
	#address-cells = <1>;

	images {
		amp3 {
			description  = "rtt-cpu3";
			data         = /incbin/("cpu3.bin");
			type         = "firmware";
			compression  = "none";
			arch         = "arm64";
			thumb        = <0>;
			hyp          = <0>;
			udelay       = <10000>;
			cpu          = <0x300>;

			compile {
				size         = <0x00800000>;
				sram_start   = <0xfdcc0000>;
				sram_size    = <0x00008000>;
				sys          = "rtt";
				core         = "ap";
				rtt_config   = "board/rk3568_evb/defconfig";
				rtt_exec     = "prebuilts/gcc/linux-x86/aarch64/arm-gnu-toolchain-13.2.Rel1-x86_64-aarch64-none-elf/bin";
				cc           = "prebuilts/gcc/linux-x86/aarch64/arm-gnu-toolchain-13.2.Rel1-x86_64-aarch64-none-elf/bin/aarch64-none-elf-";
			};

			hash {
				algo = "sha256";
			};
		};
	};

	share {
		shm_base        = <0x07400000>;
		shm_size        = <0x00400000>;
		rpmsg_base      = <0x07800000>;
		rpmsg_size      = <0x00400000>;
	};

	configurations {
		default = "conf";
		conf {
			description = "RK3568 AMP images";
			rollback-index = <0x0>;
			loadables = "amp3";

			signature {
				algo = "sha256,rsa2048";
				padding = "pss";
				key-name-hint = "dev";
				sign-images = "loadables";
			};
		};
	};
};
```

## yocto/build/conf/local.conf
```bitbake
include include/common.conf
include include/debug.conf
include include/audio.conf
include include/multimedia.conf

MACHINE = "rockchip-rk3588-rock5b"
EXTRA_IMAGE_FEATURES += "debug-tweaks"

include include/display.conf
include include/glmark2.conf
include include/browser.conf

DISPLAY_PLATFORM := "wayland"

include rksdk_override.conf
```
